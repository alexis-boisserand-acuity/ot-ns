## CMakeLists.txt
```
# Copyright (c) 2026, The OpenThread Authors
# All rights reserved.
#
# Redistribution and use in source and binary forms, with or without
# modification, are permitted provided that the following conditions are met:
# 1. Redistributions of source code must retain the above copyright
#    notice, this list of conditions and the following disclaimer.
# 2. Redistributions in binary form must reproduce the above copyright
#    notice, this list of conditions and the following disclaimer in the
#    documentation and/or other materials provided with the distribution.
# 3. Neither the name of the copyright holder nor the
#    names of its contributors may be used to endorse or promote products
#    derived from this software without specific prior written permission.
#
# THIS SOFTWARE IS PROVIDED BY THE COPYRIGHT HOLDERS AND CONTRIBUTORS "AS IS"
# AND ANY EXPRESS OR IMPLIED WARRANTIES, INCLUDING, BUT NOT LIMITED TO, THE
# IMPLIED WARRANTIES OF MERCHANTABILITY AND FITNESS FOR A PARTICULAR PURPOSE
# ARE DISCLAIMED. IN NO EVENT SHALL THE COPYRIGHT HOLDER OR CONTRIBUTORS BE
# LIABLE FOR ANY DIRECT, INDIRECT, INCIDENTAL, SPECIAL, EXEMPLARY, OR
# CONSEQUENTIAL DAMAGES (INCLUDING, BUT NOT LIMITED TO, PROCUREMENT OF
# SUBSTITUTE GOODS OR SERVICES; LOSS OF USE, DATA, OR PROFITS; OR BUSINESS
# INTERRUPTION) HOWEVER CAUSED AND ON ANY THEORY OF LIABILITY, WHETHER IN
# CONTRACT, STRICT LIABILITY, OR TORT (INCLUDING NEGLIGENCE OR OTHERWISE)
# ARISING IN ANY WAY OUT OF THE USE OF THIS SOFTWARE, EVEN IF ADVISED OF THE
# POSSIBILITY OF SUCH DAMAGE.

cmake_minimum_required(VERSION 3.20.0)

if(BOARD STREQUAL "native_sim")
  set(OT_CLI_VENDOR_EXTENSION "${CMAKE_CURRENT_SOURCE_DIR}/src/switch_vendor_cli.cmake" CACHE STRING "" FORCE)
endif()

find_package(Zephyr REQUIRED HINTS $ENV{ZEPHYR_BASE})
project(switch_input)

target_include_directories(app PRIVATE src ${CMAKE_CURRENT_SOURCE_DIR}/../common)

target_sources(app PRIVATE
  src/main.c
  src/coap_client.c
  src/switch_input.c
)

if(BOARD STREQUAL "native_sim")
  target_sources(app PRIVATE src/switch_vendor_cli.c)
endif()
```

## prj.conf
```kconfig
CONFIG_MAIN_STACK_SIZE=4096

CONFIG_GPIO=y

CONFIG_NETWORKING=y
CONFIG_NET_L2_OPENTHREAD=y

CONFIG_NET_SOCKETS=y
CONFIG_NET_UDP=y
CONFIG_COAP=y
CONFIG_COAP_CLIENT=y

CONFIG_NVS=y

CONFIG_LOG=y
CONFIG_NET_LOG=y

CONFIG_SHELL=y
CONFIG_NET_SHELL=y
CONFIG_OPENTHREAD_SHELL=y
```

## boards/native_sim.conf
```kconfig
CONFIG_IEEE802154_OTNS=y
CONFIG_OPENTHREAD_OTNS=y
CONFIG_NATIVE_SIM_SLOWDOWN_TO_REAL_TIME=n
CONFIG_FLASH_SIMULATOR=y
CONFIG_NET_L2_ETHERNET=n
CONFIG_ETH_PHY_DRIVER=n
CONFIG_NET_MGMT_EVENT_QUEUE_SIZE=10
CONFIG_NET_CONFIG_AUTO_INIT=n
CONFIG_OPENTHREAD_MANUAL_START=y
```

## src/main.c
```c
/*
 * Copyright (c) 2026, The OpenThread Authors.
 * All rights reserved.
 *
 * Redistribution and use in source and binary forms, with or without
 * modification, are permitted provided that the following conditions are met:
 * 1. Redistributions of source code must retain the above copyright
 *    notice, this list of conditions and the following disclaimer.
 * 2. Redistributions in binary form must reproduce the above copyright
 *    notice, this list of conditions and the following disclaimer in the
 *    documentation and/or other materials provided with the distribution.
 * 3. Neither the name of the copyright holder nor the
 *    names of its contributors may be used to endorse or promote products
 *    derived from this software without specific prior written permission.
 *
 * THIS SOFTWARE IS PROVIDED BY THE COPYRIGHT HOLDERS AND CONTRIBUTORS "AS IS"
 * AND ANY EXPRESS OR IMPLIED WARRANTIES, INCLUDING, BUT NOT LIMITED TO, THE
 * IMPLIED WARRANTIES OF MERCHANTABILITY AND FITNESS FOR A PARTICULAR PURPOSE
 * ARE DISCLAIMED. IN NO EVENT SHALL THE COPYRIGHT HOLDER OR CONTRIBUTORS BE
 * LIABLE FOR ANY DIRECT, INDIRECT, INCIDENTAL, SPECIAL, EXEMPLARY, OR
 * CONSEQUENTIAL DAMAGES (INCLUDING, BUT NOT LIMITED TO, PROCUREMENT OF
 * SUBSTITUTE GOODS OR SERVICES; LOSS OF USE, DATA, OR PROFITS; OR BUSINESS
 * INTERRUPTION) HOWEVER CAUSED AND ON ANY THEORY OF LIABILITY, WHETHER IN
 * CONTRACT, STRICT LIABILITY, OR TORT (INCLUDING NEGLIGENCE OR OTHERWISE)
 * ARISING IN ANY WAY OUT OF THE USE OF THIS SOFTWARE, EVEN IF ADVISED OF THE
 * POSSIBILITY OF SUCH DAMAGE.
 */

#include "coap_client.h"
#include "switch_input.h"

int main(void)
{
    switch_coap_init();
    switch_input_init();

    return 0;
}
```

## src/coap_client.c
```c
/*
 * Copyright (c) 2026, The OpenThread Authors.
 * All rights reserved.
 *
 * Redistribution and use in source and binary forms, with or without
 * modification, are permitted provided that the following conditions are met:
 * 1. Redistributions of source code must retain the above copyright
 *    notice, this list of conditions and the following disclaimer.
 * 2. Redistributions in binary form must reproduce the above copyright
 *    notice, this list of conditions and the following disclaimer in the
 *    documentation and/or other materials provided with the distribution.
 * 3. Neither the name of the copyright holder nor the
 *    names of its contributors may be used to endorse or promote products
 *    derived from this software without specific prior written permission.
 *
 * THIS SOFTWARE IS PROVIDED BY THE COPYRIGHT HOLDERS AND CONTRIBUTORS "AS IS"
 * AND ANY EXPRESS OR IMPLIED WARRANTIES, INCLUDING, BUT NOT LIMITED TO, THE
 * IMPLIED WARRANTIES OF MERCHANTABILITY AND FITNESS FOR A PARTICULAR PURPOSE
 * ARE DISCLAIMED. IN NO EVENT SHALL THE COPYRIGHT HOLDER OR CONTRIBUTORS BE
 * LIABLE FOR ANY DIRECT, INDIRECT, INCIDENTAL, SPECIAL, EXEMPLARY, OR
 * CONSEQUENTIAL DAMAGES (INCLUDING, BUT NOT LIMITED TO, PROCUREMENT OF
 * SUBSTITUTE GOODS OR SERVICES; LOSS OF USE, DATA, OR PROFITS; OR BUSINESS
 * INTERRUPTION) HOWEVER CAUSED AND ON ANY THEORY OF LIABILITY, WHETHER IN
 * CONTRACT, STRICT LIABILITY, OR TORT (INCLUDING NEGLIGENCE OR OTHERWISE)
 * ARISING IN ANY WAY OUT OF THE USE OF THIS SOFTWARE, EVEN IF ADVISED OF THE
 * POSSIBILITY OF SUCH DAMAGE.
 *
 * CoAP client wiring for the switch_input app, using Zephyr's own CoAP
 * client API (not OpenThread's otCoap API) over a plain UDP socket.
 */

#include <errno.h>

#include <zephyr/logging/log.h>
LOG_MODULE_REGISTER(coap_client_app, LOG_LEVEL_INF);

#include <zephyr/net/coap_client.h>
#include <zephyr/net/socket.h>
#include <zephyr/posix/arpa/inet.h>

#include "coap_client.h"
#include "switch_light_protocol.h"

#define NO_RESPONSE_SUPPRESS_ALL 0x1A

#define MULTICAST_HOP_LIMIT 16

static struct coap_client client;
static int                sock = -1;

void switch_coap_init(void)
{
    sock = zsock_socket(AF_INET6, SOCK_DGRAM, IPPROTO_UDP);
    if (sock < 0)
    {
        LOG_ERR("Failed to create CoAP client socket: %d", errno);
        return;
    }

    int hops = MULTICAST_HOP_LIMIT;
    int ret  = zsock_setsockopt(sock, IPPROTO_IPV6, IPV6_MULTICAST_HOPS, &hops, sizeof(hops));

    if (ret)
    {
        LOG_ERR("Failed to set CoAP multicast hop limit: %d", errno);
    }

    ret = coap_client_init(&client, NULL);

    if (ret)
    {
        LOG_ERR("Failed to init CoAP client: %d", ret);
    }
}

void switch_input_send_command(enum light_cmd cmd)
{
    static uint8_t      payload;
    struct sockaddr_in6 addr = {
        .sin6_family = AF_INET6,
        .sin6_port   = htons(LIGHT_COAP_PORT),
    };
    struct coap_client_request req = {
        .method      = COAP_METHOD_PUT,
        .confirmable = false,
        .path        = LIGHT_COAP_URI_PATH,
        .fmt         = COAP_CONTENT_FORMAT_TEXT_PLAIN,
        .payload     = &payload,
        .len         = sizeof(payload),
        .options =
            {
                {
                    .code  = COAP_OPTION_NO_RESPONSE,
                    .len   = 1,
                    .value = {NO_RESPONSE_SUPPRESS_ALL},
                },
            },
        .num_options = 1,
    };

    if (sock < 0)
    {
        LOG_ERR("CoAP client socket not ready");
        return;
    }

    payload = (uint8_t)cmd;
    zsock_inet_pton(AF_INET6, LIGHT_COAP_MULTICAST_ADDR, &addr.sin6_addr);

    int ret = coap_client_req(&client, sock, (struct sockaddr *)&addr, &req, NULL);

    if (ret)
    {
        LOG_ERR("Failed to send CoAP request: %d", ret);
    }
}
```

## src/coap_client.h
```c
/*
 * Copyright (c) 2026, The OpenThread Authors.
 * All rights reserved.
 *
 * Redistribution and use in source and binary forms, with or without
 * modification, are permitted provided that the following conditions are met:
 * 1. Redistributions of source code must retain the above copyright
 *    notice, this list of conditions and the following disclaimer.
 * 2. Redistributions in binary form must reproduce the above copyright
 *    notice, this list of conditions and the following disclaimer in the
 *    documentation and/or other materials provided with the distribution.
 * 3. Neither the name of the copyright holder nor the
 *    names of its contributors may be used to endorse or promote products
 *    derived from this software without specific prior written permission.
 *
 * THIS SOFTWARE IS PROVIDED BY THE COPYRIGHT HOLDERS AND CONTRIBUTORS "AS IS"
 * AND ANY EXPRESS OR IMPLIED WARRANTIES, INCLUDING, BUT NOT LIMITED TO, THE
 * IMPLIED WARRANTIES OF MERCHANTABILITY AND FITNESS FOR A PARTICULAR PURPOSE
 * ARE DISCLAIMED. IN NO EVENT SHALL THE COPYRIGHT HOLDER OR CONTRIBUTORS BE
 * LIABLE FOR ANY DIRECT, INDIRECT, INCIDENTAL, SPECIAL, EXEMPLARY, OR
 * CONSEQUENTIAL DAMAGES (INCLUDING, BUT NOT LIMITED TO, PROCUREMENT OF
 * SUBSTITUTE GOODS OR SERVICES; LOSS OF USE, DATA, OR PROFITS; OR BUSINESS
 * INTERRUPTION) HOWEVER CAUSED AND ON ANY THEORY OF LIABILITY, WHETHER IN
 * CONTRACT, STRICT LIABILITY, OR TORT (INCLUDING NEGLIGENCE OR OTHERWISE)
 * ARISING IN ANY WAY OUT OF THE USE OF THIS SOFTWARE, EVEN IF ADVISED OF THE
 * POSSIBILITY OF SUCH DAMAGE.
 */

#ifndef COAP_CLIENT_H_
#define COAP_CLIENT_H_

#include "switch_light_protocol.h"

void switch_coap_init(void);
void switch_input_send_command(enum light_cmd cmd);

#endif /* COAP_CLIENT_H_ */
```

## src/switch_input.c
```c
/*
 * Copyright (c) 2026, The OpenThread Authors.
 * All rights reserved.
 *
 * Redistribution and use in source and binary forms, with or without
 * modification, are permitted provided that the following conditions are met:
 * 1. Redistributions of source code must retain the above copyright
 *    notice, this list of conditions and the following disclaimer.
 * 2. Redistributions in binary form must reproduce the above copyright
 *    notice, this list of conditions and the following disclaimer in the
 *    documentation and/or other materials provided with the distribution.
 * 3. Neither the name of the copyright holder nor the
 *    names of its contributors may be used to endorse or promote products
 *    derived from this software without specific prior written permission.
 *
 * THIS SOFTWARE IS PROVIDED BY THE COPYRIGHT HOLDERS AND CONTRIBUTORS "AS IS"
 * AND ANY EXPRESS OR IMPLIED WARRANTIES, INCLUDING, BUT NOT LIMITED TO, THE
 * IMPLIED WARRANTIES OF MERCHANTABILITY AND FITNESS FOR A PARTICULAR PURPOSE
 * ARE DISCLAIMED. IN NO EVENT SHALL THE COPYRIGHT HOLDER OR CONTRIBUTORS BE
 * LIABLE FOR ANY DIRECT, INDIRECT, INCIDENTAL, SPECIAL, EXEMPLARY, OR
 * CONSEQUENTIAL DAMAGES (INCLUDING, BUT NOT LIMITED TO, PROCUREMENT OF
 * SUBSTITUTE GOODS OR SERVICES; LOSS OF USE, DATA, OR PROFITS; OR BUSINESS
 * INTERRUPTION) HOWEVER CAUSED AND ON ANY THEORY OF LIABILITY, WHETHER IN
 * CONTRACT, STRICT LIABILITY, OR TORT (INCLUDING NEGLIGENCE OR OTHERWISE)
 * ARISING IN ANY WAY OUT OF THE USE OF THIS SOFTWARE, EVEN IF ADVISED OF THE
 * POSSIBILITY OF SUCH DAMAGE.
 *
 * GPIO button wiring for the switch_input app: identical devicetree-driven
 * code on every board. On native_sim the sw0/sw1/sw2 aliases are bound to
 * the board's gpio_emul controller (see boards/native_sim.overlay); a
 * small shell helper is exposed in that case to pulse the emulated inputs,
 * exercising the exact same GPIO interrupt path as real hardware.
 */

#include <errno.h>

#include <zephyr/drivers/gpio.h>
#include <zephyr/kernel.h>
#include <zephyr/logging/log.h>
LOG_MODULE_DECLARE(coap_client_app);

#include "coap_client.h"
#include "switch_input.h"

struct switch_button
{
    const struct gpio_dt_spec gpio;
    struct gpio_callback      cb;
    enum light_cmd            cmd;
};

static void button_pressed(const struct device *dev, struct gpio_callback *cb, uint32_t pins);

static struct switch_button buttons[] = {
    {.gpio = GPIO_DT_SPEC_GET(DT_ALIAS(sw0), gpios), .cmd = LIGHT_CMD_ON},
    {.gpio = GPIO_DT_SPEC_GET(DT_ALIAS(sw1), gpios), .cmd = LIGHT_CMD_OFF},
    {.gpio = GPIO_DT_SPEC_GET(DT_ALIAS(sw2), gpios), .cmd = LIGHT_CMD_TOGGLE},
};

static void button_pressed(const struct device *dev, struct gpio_callback *cb, uint32_t pins)
{
    struct switch_button *button = CONTAINER_OF(cb, struct switch_button, cb);

    ARG_UNUSED(dev);
    ARG_UNUSED(pins);

    switch_input_send_command(button->cmd);
}

void switch_input_init(void)
{
    for (size_t i = 0; i < ARRAY_SIZE(buttons); i++)
    {
        struct switch_button *button = &buttons[i];

        if (!gpio_is_ready_dt(&button->gpio))
        {
            LOG_ERR("Button device not ready");
            continue;
        }

        int ret = gpio_pin_configure_dt(&button->gpio, GPIO_INPUT);

        if (ret)
        {
            LOG_ERR("Failed to configure button (%d)", ret);
            continue;
        }

        ret = gpio_pin_interrupt_configure_dt(&button->gpio, GPIO_INT_EDGE_TO_ACTIVE);
        if (ret)
        {
            LOG_ERR("Failed to configure button interrupt (%d)", ret);
            continue;
        }

        gpio_init_callback(&button->cb, button_pressed, BIT(button->gpio.pin));
        gpio_add_callback_dt(&button->gpio, &button->cb);
    }
}

#ifdef CONFIG_GPIO_EMUL
#include <zephyr/drivers/gpio/gpio_emul.h>

void switch_input_press(enum light_cmd cmd)
{
    for (size_t i = 0; i < ARRAY_SIZE(buttons); i++)
    {
        if (buttons[i].cmd == cmd)
        {
            gpio_emul_input_set_dt(&buttons[i].gpio, 0);
            gpio_emul_input_set_dt(&buttons[i].gpio, 1);
            return;
        }
    }
}
#endif
```

## src/switch_input.h
```c
/*
 * Copyright (c) 2026, The OpenThread Authors.
 * All rights reserved.
 *
 * Redistribution and use in source and binary forms, with or without
 * modification, are permitted provided that the following conditions are met:
 * 1. Redistributions of source code must retain the above copyright
 *    notice, this list of conditions and the following disclaimer.
 * 2. Redistributions in binary form must reproduce the above copyright
 *    notice, this list of conditions and the following disclaimer in the
 *    documentation and/or other materials provided with the distribution.
 * 3. Neither the name of the copyright holder nor the
 *    names of its contributors may be used to endorse or promote products
 *    derived from this software without specific prior written permission.
 *
 * THIS SOFTWARE IS PROVIDED BY THE COPYRIGHT HOLDERS AND CONTRIBUTORS "AS IS"
 * AND ANY EXPRESS OR IMPLIED WARRANTIES, INCLUDING, BUT NOT LIMITED TO, THE
 * IMPLIED WARRANTIES OF MERCHANTABILITY AND FITNESS FOR A PARTICULAR PURPOSE
 * ARE DISCLAIMED. IN NO EVENT SHALL THE COPYRIGHT HOLDER OR CONTRIBUTORS BE
 * LIABLE FOR ANY DIRECT, INDIRECT, INCIDENTAL, SPECIAL, EXEMPLARY, OR
 * CONSEQUENTIAL DAMAGES (INCLUDING, BUT NOT LIMITED TO, PROCUREMENT OF
 * SUBSTITUTE GOODS OR SERVICES; LOSS OF USE, DATA, OR PROFITS; OR BUSINESS
 * INTERRUPTION) HOWEVER CAUSED AND ON ANY THEORY OF LIABILITY, WHETHER IN
 * CONTRACT, STRICT LIABILITY, OR TORT (INCLUDING NEGLIGENCE OR OTHERWISE)
 * ARISING IN ANY WAY OUT OF THE USE OF THIS SOFTWARE, EVEN IF ADVISED OF THE
 * POSSIBILITY OF SUCH DAMAGE.
 */

#ifndef SWITCH_INPUT_H_
#define SWITCH_INPUT_H_

#include "switch_light_protocol.h"

void switch_input_init(void);

#ifdef CONFIG_GPIO_EMUL
void switch_input_press(enum light_cmd cmd);
#endif

#endif /* SWITCH_INPUT_H_ */
```

## src/switch_vendor_cli.c
```c
/*
 * Copyright (c) 2026, The OpenThread Authors.
 * All rights reserved.
 *
 * Redistribution and use in source and binary forms, with or without
 * modification, are permitted provided that the following conditions are met:
 * 1. Redistributions of source code must retain the above copyright
 *    notice, this list of conditions and the following disclaimer.
 * 2. Redistributions in binary form must reproduce the above copyright
 *    notice, this list of conditions and the following disclaimer in the
 *    documentation and/or other materials provided with the distribution.
 * 3. Neither the name of the copyright holder nor the
 *    names of its contributors may be used to endorse or promote products
 *    derived from this software without specific prior written permission.
 *
 * THIS SOFTWARE IS PROVIDED BY THE COPYRIGHT HOLDERS AND CONTRIBUTORS "AS IS"
 * AND ANY EXPRESS OR IMPLIED WARRANTIES, INCLUDING, BUT NOT LIMITED TO, THE
 * IMPLIED WARRANTIES OF MERCHANTABILITY AND FITNESS FOR A PARTICULAR PURPOSE
 * ARE DISCLAIMED. IN NO EVENT SHALL THE COPYRIGHT HOLDER OR CONTRIBUTORS BE
 * LIABLE FOR ANY DIRECT, INDIRECT, INCIDENTAL, SPECIAL, EXEMPLARY, OR
 * CONSEQUENTIAL DAMAGES (INCLUDING, BUT NOT LIMITED TO, PROCUREMENT OF
 * SUBSTITUTE GOODS OR SERVICES; LOSS OF USE, DATA, OR PROFITS; OR BUSINESS
 * INTERRUPTION) HOWEVER CAUSED AND ON ANY THEORY OF LIABILITY, WHETHER IN
 * CONTRACT, STRICT LIABILITY, OR TORT (INCLUDING NEGLIGENCE OR OTHERWISE)
 * ARISING IN ANY WAY OUT OF THE USE OF THIS SOFTWARE, EVEN IF ADVISED OF THE
 * POSSIBILITY OF SUCH DAMAGE.
 */

#include <string.h>

#include <zephyr/sys/util.h>
#include <openthread/cli.h>

#include "switch_input.h"
#include "switch_light_protocol.h"

static otError switchCommand(void *aContext, uint8_t aArgsLength, char *aArgs[])
{
    (void)aContext;

    if (aArgsLength != 2 || strcmp(aArgs[0], "press") != 0)
    {
        return OT_ERROR_INVALID_ARGS;
    }

    if (!strcmp(aArgs[1], "on"))
    {
        switch_input_press(LIGHT_CMD_ON);
    }
    else if (!strcmp(aArgs[1], "off"))
    {
        switch_input_press(LIGHT_CMD_OFF);
    }
    else if (!strcmp(aArgs[1], "toggle"))
    {
        switch_input_press(LIGHT_CMD_TOGGLE);
    }
    else
    {
        return OT_ERROR_INVALID_ARGS;
    }

    return OT_ERROR_NONE;
}

static const otCliCommand sSwitchCommands[] = {
    {"switch", switchCommand},
};

void otCliVendorSetUserCommands(void) { otCliSetUserCommands(sSwitchCommands, ARRAY_SIZE(sSwitchCommands), NULL); }
```
